/*
 * oled_display.c
 *
 *  Created on: Jul 7, 2025
 *      Author: makar
 */
#define OLED_RES_SET()		HAL_GPIO_WritePin(GPIOA, GPIO_PIN_2, SET)
#define OLED_DC_SET()		HAL_GPIO_WritePin(GPIOA, GPIO_PIN_3, SET)
#define OLED_CS_SET()		HAL_GPIO_WritePin(GPIOA, GPIO_PIN_4, SET)

#define OLED_RES_RESET()    HAL_GPIO_WritePin(GPIOA, GPIO_PIN_2, RESET)
#define OLED_DC_RESET()		HAL_GPIO_WritePin(GPIOA, GPIO_PIN_3, RESET)
#define OLED_CS_RESET()		HAL_GPIO_WritePin(GPIOA, GPIO_PIN_4, RESET)

#define WIDTH 				128
#define HEIGHT 				64
#define PAGE_COUNT 			8
#define SYMBOL_7x4_COLMNS	5
#define FIRST_SYMBOL_ID		32
#define LAST_SYMBOL_ID		128

#include "oled_display.h"
#include <string.h>

static const uint8_t symbols[96][5] = {
		{ 0x00, 0x00, 0x00, 0x00, 0x00 }, // ' ' (space)
		{ 0x00, 0x00, 0x5F, 0x00, 0x00 }, // '!'
		{ 0x00, 0x07, 0x00, 0x07, 0x00 }, // '"'
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		{ 0x08, 0x08, 0x2A, 0x1C, 0x08 }, // '→'
		};

void oled_power() {
	HAL_Delay(20);
	OLED_RES_RESET();
	HAL_Delay(30);
	OLED_RES_SET();
}

void oled_cmd_send(SPI_HandleTypeDef *spi, uint8_t cmd) {
	uint8_t rx = 0;

	OLED_DC_RESET();
	OLED_CS_RESET();
	HAL_SPI_TransmitReceive(spi, &cmd, &rx, sizeof(cmd), 1000);
	OLED_CS_SET();
	OLED_DC_SET();

}

void oled_ram_send_byte(SPI_HandleTypeDef *spi, uint8_t data) {
	uint8_t rx = 0;

	OLED_DC_SET();
	OLED_CS_RESET();
	HAL_SPI_TransmitReceive(spi, &data, &rx, sizeof(data), 1000);
	OLED_CS_SET();
	OLED_DC_RESET();

}

void oled_ram_send(SPI_HandleTypeDef *spi, uint8_t data, uint32_t size) {
	uint8_t rx[size];

	OLED_DC_SET();
	OLED_CS_RESET();
	HAL_SPI_TransmitReceive(spi, &data, rx, size, 100);
	OLED_CS_SET();
	OLED_DC_RESET();

}

void oled_init(SPI_HandleTypeDef *spi) {
	// if dc LOW = cmd, if dc HIGH = ram
	oled_power();
	oled_cmd_send(spi, 0xAE); // Display OFF
	oled_cmd_send(spi, 0x20); // Set Memory Addressing Mode
	oled_cmd_send(spi, 0x00); // Horizontal Addressing Mode

	oled_cmd_send(spi, 0xB0); // Set Page Start Address for Page Addressing Mode
	oled_cmd_send(spi, 0xC8); // COM Output Scan Direction

	oled_cmd_send(spi, 0x00); // Low Column Address
	oled_cmd_send(spi, 0x10); // High Column Address

	oled_cmd_send(spi, 0x40); // Set Start Line Address
	oled_cmd_send(spi, 0x81); // Set Contrast Control
	oled_cmd_send(spi, 0x7F); // Contrast = 127

	oled_cmd_send(spi, 0xA1); // Segment Re-map
	oled_cmd_send(spi, 0xA6); // Normal display

	oled_cmd_send(spi, 0xA8); // Set Multiplex Ratio
	oled_cmd_send(spi, 0x3F); // 1/64 duty

	oled_cmd_send(spi, 0xA4); // Output RAM to Display
	oled_cmd_send(spi, 0xD3); // Display Offset
	oled_cmd_send(spi, 0x00); // No offset

	oled_cmd_send(spi, 0xD5); // Display Clock Divide Ratio
	oled_cmd_send(spi, 0x80); // Suggested ratio

	oled_cmd_send(spi, 0xD9); // Pre-charge Period
	oled_cmd_send(spi, 0xF1);

	oled_cmd_send(spi, 0xDA); // COM Pins Hardware Configuration
	oled_cmd_send(spi, 0x12);

	oled_cmd_send(spi, 0xDB); // VCOMH Deselect Level
	oled_cmd_send(spi, 0x40);

	oled_cmd_send(spi, 0x8D); // Enable charge pump regulator
	oled_cmd_send(spi, 0x14);

	oled_cmd_send(spi, 0xAF); // Display ON

}

void oled_clear(SPI_HandleTypeDef *spi) {
	for (int j = 0; j < PAGE_COUNT; ++j) {
		oled_cmd_send(spi, 0xB0 + j);
		oled_cmd_send(spi, 0x00);
		oled_cmd_send(spi, 0x10);
		for (int i = 0; i < WIDTH; ++i) {
			oled_ram_send_byte(spi, 0x00);
		}
	}
	oled_cmd_send(spi, 0x00);
	oled_cmd_send(spi, 0x10);
	oled_cmd_send(spi, 0xB0);

}

void oled_fill(SPI_HandleTypeDef *spi, uint8_t value) {
	for (int j = 0; j < PAGE_COUNT; ++j) {
		oled_cmd_send_byte(spi, 0xB0 + j);
		oled_cmd_send(spi, 0x00);
		oled_cmd_send(spi, 0x10);
		for (int i = 0; i < WIDTH; ++i) {
			oled_ram_send_byte(spi, value);
		}
	}
	oled_cmd_send(spi, 0x00);
	oled_cmd_send(spi, 0x10);
	oled_cmd_send(spi, 0xB0);
}

int oled_draw_char(SPI_HandleTypeDef *spi, char c) {
	if (c < FIRST_SYMBOL_ID || c > LAST_SYMBOL_ID) {
		return 0;
	} else {
		for (int i = 0; i < SYMBOL_7x4_COLMNS; i++) {
			oled_ram_send_byte(spi, symbols[c - 32][i]);
		}
		oled_ram_send_byte(spi, 0x00);
		return 1;
	}


}

void oled_string_print(SPI_HandleTypeDef *spi, const char *str) {
	for (int i = 0; i < strlen(str); ++i) {
		oled_draw_char(spi, str[i]);
	}
}

void oled_string_println(SPI_HandleTypeDef *spi, const char *str) {
	for (int i = 0; i < strlen(str); ++i) {
		oled_draw_char(spi, str[i]);
	}
	oled_cmd_send(spi, 0x00);
	oled_cmd_send(spi, 0x10);
	oled_cmd_send(spi, 0xB0 + 1);
}
